#include "constants/constants.h"
#if UI_BACKEND == UI_BACKEND_U8G2
#include "constants/constants.h"
#include "constants/ui.h"
#include "contest.h"
#include "error.h"
#include "helperUi.h"
#include "macro/ui.h"
#include "menuUi.h"
#include "page.h"
#include "settings.h"
#include "ui.h"
#include <Arduino.h>
#include <U8g2lib.h>
#include <stdarg.h>

// 'Capture', 70x40px LOGO
const unsigned char epd_bitmap_Capture[] PROGMEM = {
  0xff, 0xff, 0xff, 0xff, 0xff, 0xff, 0xff, 0xff, 0x3f, 0xff, 0xff, 0xff, 0xff,
  0xff, 0xff, 0xff, 0xff, 0x3f, 0xff, 0xff, 0xff, 0xff, 0xff, 0xff, 0xff, 0xff,
  0x3f, 0xff, 0xff, 0xff, 0xff, 0xff, 0xff, 0xff, 0xff, 0x3f, 0xff, 0xff, 0xff,
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  0xff, 0x7f, 0xff, 0xff, 0xff, 0xff, 0xff, 0xff, 0x3f
};

UI::UI () : OLED_CLASS (U8G2_R0, /* reset=*/U8X8_PIN_NONE)
{
  menuUI = new MenuUI (this);
}

UI::~UI () { delete menuUI; }

void
UI::initDisplay (int sda, int scl)
{
  (void)sda;
  (void)scl;
  OLED_CLASS::begin ();
  clearDisplay ();
}

void
UI::permanent ()
{
  // version
  // RAW_WRITE_ROW (U8G2_FIRST_ROW, nullptr, nullptr, VERSION, this);
  drawStr (VERSION_X, VERSION_Y, VERSION);
}

void
UI::initUI ()
{
}

MenuUI &
UI::getMenuUI ()
{
  return *menuUI;
}

IDisplay &
UI::setTemperature (float temp)
{
  this->_temperature = temp;
  return *this;
}

void
UI::main ()
{
  // columns
  RAW_WRITE_ROW (U8G2_FIRST_ROW, nullptr, PREVIEW_ACP_TEXT,
                 PREVIEW_COLUMN_TEMP, this);
  // rows

  // main sensor
  if (_mainTemp)
    // AT_WRITE_ROW (U8G2_SECOND_ROW, PREVIEW_TEMP, *_mainSensor);
    N_AT_WRITE_ROW (U8G2_SECOND_ROW, PREVIEW_TEMP, _mainTemp, _mainAcp);

  // first reserve sensor
  if (_firstResTemp)
    N_AT_WRITE_ROW (U8G2_THIRD_ROW, PREVIEW_FIRST_RESERVE, _firstResTemp,
                    _firstResAcp);

  // second reserve sensor
  if (_secondResTemp)
    N_AT_WRITE_ROW (U8G2_FOURTH_ROW, PREVIEW_SECOND_RESERVE, _secondResTemp,
                    _secondResAcp);

  // street sensor
  if (_streetTemp)
    N_AT_WRITE_ROW (U8G2_FIFTH_ROW, PREVIEW_STREET, _streetTemp, _streetAcp);
}

void
UI::draw ()
{
  // initUI();
  setFont (FONT_UI);
  this->firstPage ();
  do
    {
      permanent ();
      switch (Page::getCurrentPage ())
        {
        case MAIN_PAGE:
          main ();
          break;
        case SETTINGS:
          menuUI->draw ();
          break;
        case ERROR:
          error ();
        default:
          break;
        }
    }
  while (this->nextPage ());
}

void
UI::startWindow ()
{
  setFont (FONT_START);
  this->firstPage ();
  do
    {
      drawCentered ("Factory IRBIS", 0, 25);
      this->drawXBMP (CENTER_X / 2, CENTER_Y / 2, 70, 40, epd_bitmap_Capture);
    }
  while (this->nextPage ());
  delay (START_MENU_DURATION);
}

int
UI::drawCentered (const char *text, int padding_top, int padding_bottom,
                  int padding_left, int padding_right)
{
  int x = (OLED_WIDTH - this->getStrWidth (text)) / 2;
  int y = (OLED_HEIGHT + this->getFontAscent ()) / 2;
  this->drawStr (x + padding_left - padding_right,
                 y + padding_top - padding_bottom, text);
  return y;
}

void
UI::clearDisplay ()
{
  OLED_CLASS::clear ();
}

void
UI::setFont (UiFont font)
{
  switch (font)
    {
    case FONT_START:
      OLED_CLASS::setFont (START_FONT);
      break;
    case FONT_UI:
    default:
      OLED_CLASS::setFont (FONT);
      break;
    }
}

void
UI::drawStr (int x, int y, const char *str)
{
  OLED_CLASS::drawStr (x, y, str);
}
int
UI::getStrWidth (const char *str)
{
  return OLED_CLASS::getStrWidth (str);
}
int
UI::getFontHeight ()
{
  return OLED_CLASS::getFontAscent ();
}

void
UI::error ()
{
  const char *error_message = Error::getErrorMessage ();
  drawStr (_CENTER_X (*this, error_message), _CENTER_Y (*this), error_message);
  // free (error_message);
}

#endif
